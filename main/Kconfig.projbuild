## main/Kconfig.projbuild
```kconfig
menu "App Configuration"
    rsource "../$(MY_ESP_LIBRARIES_PATH)/provision/provision.projbuild"
    rsource "../$(MY_ESP_LIBRARIES_PATH)/mqtt_tools/mqtt.projbuild"                       
    config SENSORS_COLLECTION_TIMEOUT
        int
        default 5
        prompt "Sensors collection timeout(sec)"
    
    config POOL_INTERVAL_DEFAULT
        int "POOL_INTERVAL_DEFAULT sec"
        default 600
        
    config POOL_INTERVAL_RETRY
        int "POOL_INTERVAL_RETRY sec"
        default 60

    menu "Board"
        config I2C_MASTER_SCL_IO
                int
                default 9
                prompt "I2C_MASTER_SCL_IO"
        config I2C_MASTER_SDA_IO
                int
                default 8
                prompt "I2C_MASTER_SDA_IO"
    endmenu

    menu "Clock"
        config SNTP_TIME_SERVER
            string "SNTP server name"
            default "pool.ntp.org"
            help
                Hostname of the main SNTP server.
        config TIMEZONE
            string "TIMEZONE"
            default "EET-2EEST,M3.5.0/3,M10.5.0/4"
    endmenu

    menu "Sensors"
        config SENSORS_KA_PERIOD_S
            int "SENSORS_KA_PERIOD_S"
            default 600
            help
                sensor keep alive period sec, resend value if it unchanged
        config LIGHTING_REFRESH
            int "LIGHTING_REFRESH"
            default 200
            help
                LIGHTING_REFRESH ms
        config LIGHTING_THRESHOLD
            int "LIGHTING_THRESHOLD"
            default 10
        config LIGHTING_MIN_RAW
            int "LIGHTING_MIN_RAW"
            default 10
        config LIGHTING_MAX_RAW
            int "LIGHTING_MAX_RAW"
            default 4096
    endmenu

    menu "Display"
        config DISPLAY_SEGMENTS
            int "DISPLAY_SEGMENTS"
            default 4

        config DISPLAY_SEGMENT_ROTATION
            int "DISPLAY_SEGMENT_ROTATION"
            default 3
            help
                SEGMENT_ROTATION
        config DISPLAY_SEGMENT_UPSIDEDOWN
            int "DISPLAY_SEGMENT_UPSIDEDOWN"
            default 0
            help
                SEGMENT_UPSIDEDOWN
        config DISPLAY_MIRRORED
            int "DISPLAY_MIRRORED"
            default 0
            help
                DISPLAY_MIRRORED

    endmenu

    menu "SvitloBot"
        config SVITLOBOT_URL
            string "SvitloBot channelPing URL"
            default "https://api.svitlobot.in.ua/channelPing"
            help
                Channel key is not configured here: it lives in the
                git-ignored main/svitlobot_secret.h.
        config SVITLOBOT_INTERVAL_S
            int "Ping interval (sec)"
            range 65 600
            default 120
            help
                The API allows one request per minute and answers HTTP 429
                ("That's too fast bro") to anything faster, without recording
                the ping. system keepalive timeout is 4min, so 120s is enough.
        config SVITLOBOT_STARTUP_JITTER_S
            int "Startup jitter (sec, 0 = off)"
            range 0 600
            default 30
            help
                Random delay before the very first ping after boot. Power
                restoration brings every device on the grid up at once, and
                without jitter they all hit the API in the same second. Only the
                first ping is delayed; the periodic ones are not.
                Must not exceed SVITLOBOT_INTERVAL_S (checked by a
                static_assert), otherwise the channel would already read as
                offline before the first ping goes out.
        config SVITLOBOT_TIMEOUT_S
            int "HTTP request timeout (sec)"
            range 3 30
            default 8
            help
                Applied per socket operation, not to the whole request, so a
                single ping can take longer. Keep it small enough that a failed
                ping plus a retry still fit inside SVITLOBOT_INTERVAL_S.
    endmenu

endmenu
```
